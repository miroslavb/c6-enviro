## firmware/main/Kconfig.projbuild
```kconfig
menu "C6 Enviro Sensor"

    menu "Pins (ESP32-C6 Super Mini)"

        config ENVIRO_I2C_SDA_GPIO
            int "BME680 I2C SDA GPIO"
            default 22
            help
                Any free GPIO works (the C6 routes I2C through the GPIO matrix).
                GPIO20-23 are the "safe picks" on the Super Mini (no strapping,
                no flash, no USB). Default 22 matches docs/WIRING.md.

        config ENVIRO_I2C_SCL_GPIO
            int "BME680 I2C SCL GPIO"
            default 23

        config ENVIRO_VBAT_ADC_GPIO
            int "Battery-sense ADC GPIO (must be GPIO0..6 = ADC1)"
            range 0 6
            default 2
            help
                Battery positive terminal reaches this pin through the resistor
                divider described in docs/WIRING.md. Only GPIO0-6 are ADC1
                channels on the C6.

        config ENVIRO_LED_GPIO
            int "WS2812 status LED GPIO"
            default 8
            help
                Onboard WS2812 on the C6 Super Mini (also a strapping pin —
                output-only use after boot is safe).

    endmenu

    menu "Battery sense"

        config ENVIRO_VBAT_DIV_NUM
            int "Divider ratio numerator (Vbat = Vadc * NUM / DEN)"
            default 2
            help
                With the recommended equal-value divider (2 x 200 kΩ) the ADC
                sees Vbat/2, so NUM/DEN = 2/1.

        config ENVIRO_VBAT_DIV_DEN
            int "Divider ratio denominator"
            default 1

        config ENVIRO_VBAT_SAMPLES
            int "ADC samples averaged per reading"
            default 8

    endmenu

    menu "BME680"

        config ENVIRO_GAS_HEATER_TEMP_C
            int "Gas heater target temperature, °C"
            default 300

        config ENVIRO_GAS_HEATER_DUR_MS
            int "Gas heater duration, ms"
            default 100

    endmenu

    menu "Cycle / power"

        config ENVIRO_REPORT_FLUSH_MS
            int "Time to keep the radio up after setting attributes, ms"
            default 2000
            help
                The ZBOSS reporting engine transmits the changed attributes
                within this window; then the device deep-sleeps. Lower = less
                energy per cycle but risks cutting off an unsent report.

        config ENVIRO_MIN_SLEEP_MS
            int "Minimum deep-sleep duration, ms"
            default 500
            help
                Floor for the interval-compensated sleep calculation so a slow
                cycle can never spin the device into a zero-sleep loop.

        config ENVIRO_JOIN_TIMEOUT_S
            int "Give up steering / rejoining after this many seconds"
            default 60
            help
                Battery protection: an unjoined device scanning channels burns
                ~80 mA. After the timeout it deep-sleeps for
                ENVIRO_RETRY_SLEEP_S and tries again.

        config ENVIRO_RETRY_SLEEP_S
            int "Sleep between failed join attempts, seconds"
            default 60

    endmenu

endmenu
```

## firmware/sdkconfig.defaults
```kconfig
# =============================================================================
# sdkconfig.defaults — ESP32-C6 Super Mini enviro sensor (sleepy Zigbee ED)
# These seed `sdkconfig` on first configure. Single-core RISC-V C6, 4 MB flash,
# NO PSRAM. Every non-obvious option is commented with WHY.
# =============================================================================

# ---- Target ----------------------------------------------------------------
CONFIG_IDF_TARGET="esp32c6"

# ---- Flash / partitions ----------------------------------------------------
# ESP32-C6FH4 = 4 MB in-package flash. DIO is the safe default mode.
CONFIG_ESPTOOLPY_FLASHSIZE_4MB=y
CONFIG_ESPTOOLPY_FLASHMODE_DIO=y
# Custom single-app + zb_storage/zb_fct table (no OTA; flashed from the browser).
CONFIG_PARTITION_TABLE_CUSTOM=y
CONFIG_PARTITION_TABLE_CUSTOM_FILENAME="partitions.csv"

# ---- Console: native USB-Serial-JTAG ---------------------------------------
# No UART bridge chip on the Super Mini; the console rides the built-in
# USB-Serial-JTAG (GPIO12/13). Do NOT repurpose those GPIOs or USB dies.
CONFIG_ESP_CONSOLE_USB_SERIAL_JTAG=y
CONFIG_ESP_CONSOLE_SECONDARY_NONE=y

# ---- Zigbee: SLEEPY END DEVICE (ZED) ----------------------------------------
# CONFIG_ZB_ZED links libesp-zigbee-core.zed.a — the end-device ZBOSS variant.
# (The sibling display/radiometer projects are ZCZR routers; this device runs
# on a battery and deep-sleeps, so it must be an end device.)
CONFIG_ZB_ENABLED=y
CONFIG_ZB_ZED=y
# esp-zigbee-lib 2.x: the stable 1.x SDK API (esp_zigbee_core.h, esp_zb_*)
# lives under include/compat and is ONLY exposed when this is set.
CONFIG_ZB_SDK_1xx=y
# Native on-die 802.15.4 radio.
CONFIG_ZB_RADIO_NATIVE=y
CONFIG_IEEE802154_ENABLED=y

# ---- Deep sleep -------------------------------------------------------------
# Skip the bootloader's image re-validation on deep-sleep wake: shaves real
# milliseconds off every 3 s cycle (we wake ~28k times a day).
CONFIG_BOOTLOADER_SKIP_VALIDATE_IN_DEEP_SLEEP=y
# System time source that survives deep sleep sanely (per the esp-zigbee
# deep_sleep example's defaults).
CONFIG_NEWLIB_TIME_SYSCALL_USE_RTC_HRT=y
# NOTE deliberately ABSENT: CONFIG_PM_ENABLE / tickless idle /
# CONFIG_IEEE802154_SLEEP_ENABLE / esp_zb_sleep_enable() — those are the
# LIGHT-sleep machinery. This firmware uses pure timer-wake deep sleep; the
# stack restores the network from the zb_storage NVRAM partition on wake.

# ---- Radios we DON'T use → free RAM/flash ----------------------------------
CONFIG_BT_ENABLED=n

# ---- Main task / FreeRTOS ---------------------------------------------------
CONFIG_ESP_MAIN_TASK_STACK_SIZE=6144
CONFIG_FREERTOS_HZ=1000

# ---- Logging ----------------------------------------------------------------
# Info level: the web serial console is a first-class debug surface for this
# device family (join issues are log-diagnosable). The cost per cycle is small
# and the console is only attached on the bench.
CONFIG_LOG_DEFAULT_LEVEL_INFO=y

# ---- Newlib -----------------------------------------------------------------
CONFIG_NEWLIB_NANO_FORMAT=n
```
